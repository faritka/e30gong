## drivers/Kconfig
```kconfig
# Copyright (c) 2021
# SPDX-License-Identifier: Apache-2.0

menu "Drivers"
rsource "dac/Kconfig"
rsource "pm/Kconfig"
endmenu
```

## drivers/dac/Kconfig
```kconfig
# Copyright (c) 2021
# SPDX-License-Identifier: Apache-2.0

menu "Drivers DAC"
rsource "stm32ldac/Kconfig"
endmenu
```

## drivers/dac/stm32ldac/Kconfig
```kconfig
# Copyright (c) 2023
# SPDX-License-Identifier: Apache-2.0

config STM32LDAC
	bool "Signal from the DAC of STM32L452RE"
	depends on SOC_FAMILY_STM32
	select USE_STM32_LL_PWR
	select USE_STM32_LL_RCC
	select USE_STM32_LL_EXTI
	select USE_STM32_LL_DMA
	select USE_STM32_LL_TIM
	select USE_STM32_LL_DAC
    select USE_STM32_LL_GPIO
	help
	  Enable dac signal in STM32L452
```

## drivers/pm/Kconfig
```kconfig
# Copyright (c) 2021
# SPDX-License-Identifier: Apache-2.0

menu "Drivers Power Management"
rsource "stm32lpm/Kconfig"
endmenu
```

## drivers/pm/stm32lpm/Kconfig
```kconfig
# Copyright (c) 2022
# SPDX-License-Identifier: Apache-2.0

config STM32LPM
	bool "The Standby power mode for STM32L452RE"
	depends on SOC_FAMILY_STM32
	select USE_STM32_LL_PWR
	select USE_STM32_LL_RCC
	select USE_STM32_LL_EXTI
    select USE_STM32_LL_GPIO
	help
	  Switch the STM32L452 to the Standby power mode
```

## dts/bindings/dac/st,stm32dac.yaml
```yaml
# Copyright (c) 2023, Farit N
# SPDX-License-Identifier: Apache-2.0

description: DAC for SMT32

compatible: "st,stm32dac"

include: base.yaml

properties:
    enable-gpios:
        type: phandle-array
        description: The GPIO that enables the audio amplifier
        required: false
```

## dts/bindings/pm/st,stm32pm.yaml
```yaml
# Copyright (c) 2023, Farit N
# SPDX-License-Identifier: Apache-2.0

description: Power Management for SMT32

compatible: "st,stm32pm"

include: base.yaml

properties:
    wakeup-gpios:
        type: phandle-array
        description: The array of the Wakeup GPIOs
        required: false
```
